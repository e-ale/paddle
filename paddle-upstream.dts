/*
 * BaconBits paddle game controller overlay
 * Version for upstream kernel
 *
 * Copyright 2018 Konsulko Group
 * Matt Porter <mporter@konsulko.com>
 *
 * This program is free software; you can redistribute it and/or
 * modify it under the terms of the GNU General Public License as
 * published by the Free Software Foundation version 2.
 *
 * This program is distributed "as is" WITHOUT ANY WARRANTY of any
 * kind, whether express or implied; without even the implied warranty
 * of MERCHANTABILITY or FITNESS FOR A PARTICULAR PURPOSE.  See the
 * GNU General Public License for more details.
 */

/dts-v1/;
/plugin/;

#include <dt-bindings/gpio/gpio.h>
#include <dt-bindings/pinctrl/omap.h>

/ {
	fragment@0 {
		target = <&am33xx_pinmux>;
		__overlay__ {
			gpio1_13_pin: pinmux-gpio1-13-pin {
				pinctrl-single,pins = <
                			AM33XX_IOPAD(0x0834, PIN_INPUT | MUX_MODE7)
				>;
			};
		};
	};

	fragment@1 {
		target = <&l4_wkup>;
		__overlay__ {
			paddle {
				compatible = "e-ale,baconbits-paddle";
				pinctrl-0 = <&gpio1_13_pin>;
				io-channels = <&am335x_adc 0>;
				io-channel-names = "thumbwheel";
				button-gpios = <&gpio1 13 GPIO_ACTIVE_LOW>;
			};
		};
	};
};
